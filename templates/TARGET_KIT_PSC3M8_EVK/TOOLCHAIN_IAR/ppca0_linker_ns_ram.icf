/*******************************************************************************
* \file ppca0_linker_ns_ram.icf
* \version 1.000
*
* Linker file for the IAR compiler.
*
* The main purpose of the linker script is to describe how the sections in the
* input files should be mapped into the output file, and to control the memory
* layout of the output file.
*
* \note The entry point is fixed and starts at 0x02010000. The valid application
* image should be placed there.
*
* \note The linker files included with the PDL template projects must be generic
* and handle all common use cases. Your project may not use every section
* defined in the linker files. In that case you may see warnings during the
* build process. In your project, you can simply comment out or remove the
* relevant code in the linker file.
*
********************************************************************************
* \copyright
* Copyright (c) (2020-2024), Cypress Semiconductor Corporation (an Infineon company) or
* an affiliate of Cypress Semiconductor Corporation.
* SPDX-License-Identifier: Apache-2.0
*
* Licensed under the Apache License, Version 2.0 (the "License");
* you may not use this file except in compliance with the License.
* You may obtain a copy of the License at
*
*     http://www.apache.org/licenses/LICENSE-2.0
*
* Unless required by applicable law or agreed to in writing, software
* distributed under the License is distributed on an "AS IS" BASIS,
* WITHOUT WARRANTIES OR CONDITIONS OF ANY KIND, either express or implied.
* See the License for the specific language governing permissions and
* limitations under the License.
*******************************************************************************/

/* Include the device memory definitions generated by the Device Configurator */
include  "../config/GeneratedSource/cymem_ilinkarm_CM33_1.icf";

if (!isdefinedsymbol(BUILD_NUM)) {
  define symbol BUILD_NUM = 0;
}

if ((BUILD_NUM % 2) == 0) {
  define symbol PPCA0_CODE_START = CYMEM_CM33_1_ppca0_code_A_START;
  define symbol PPCA0_CODE_SIZE  = CYMEM_CM33_1_ppca0_code_A_SIZE;
  define symbol PPCA0_CRC_START  = CYMEM_CM33_1_ppca0_crc_A_START;
} else {
  define symbol PPCA0_CODE_START = CYMEM_CM33_1_ppca0_code_B_START;
  define symbol PPCA0_CODE_SIZE  = CYMEM_CM33_1_ppca0_code_B_SIZE;
  define symbol PPCA0_CRC_START  = CYMEM_CM33_1_ppca0_crc_B_START;
}

if (!isdefinedsymbol(__STACK_SIZE)) {
  define symbol __ICFEDIT_size_cstack__ = 0x800;
} else {
  define symbol __ICFEDIT_size_cstack__ = __STACK_SIZE;
}
define symbol __ICFEDIT_size_proc_stack__ = 0x0;

/* Defines the minimum heap size. The actual heap size will be expanded to the end of the stack region */
if (!isdefinedsymbol(__HEAP_SIZE)) {
    define symbol __ICFEDIT_size_heap__ = 0x0400;
} else {
  define symbol __ICFEDIT_size_heap__ = __HEAP_SIZE;
}

/* Include the memory regions generated by the Device Configurator.
  This file contains the memory region definitions for the device,
  which are used to define the memory layout in this linker script. */
include  "../config/GeneratedSource/cymem_ilinkarm_regions_CM33_1.icf";

define block CSTACK     with alignment = 8, size = __ICFEDIT_size_cstack__     { };
define block PROC_STACK with alignment = 8, size = __ICFEDIT_size_proc_stack__ { };
define block HEAP       with expanding size, alignment = 8, minimum size = __ICFEDIT_size_heap__ { };
define block HSTACK {block HEAP, block PROC_STACK, last block CSTACK};
define block RO     {first section .intvec, readonly};
define block CRC        with alignment = 4 { section .crc_section};
define block PPCA_SHM   with fixed order { section .cy_ppca_shm, section .cy_ppca_shm.lib };

/*-Initializations-*/
initialize by copy { readwrite };
do not initialize  { section .noinit, section .intvec_ram };
do not initialize  { section .cy_ppca_shm* };
/* Live update persistent data must not be initialized by startup .bss/.data init */
do not initialize  { section .cy_live_persistent_data };

/*-Placement-*/

/* Flash - Cortex-M33 application */
place at address (PPCA0_CODE_START) { block RO };
place at address (PPCA0_CRC_START)  { block CRC };

/* RAM */
place at start of ppca0_data  { readwrite section .intvec_ram};
place in          ppca0_data  { readwrite };
place at end   of ppca0_data  { block HSTACK };

place at start of ppca_shm_data { block PPCA_SHM };
place at end   of ppca_shm_data { readwrite section .cy_sharedmem };
/* Live update persistent data - survives firmware updates */
place in ppca0_live_persistent_data { section .cy_live_persistent_data };

keep {  section .intvec  };
keep {  section .crc_section*  };
keep {  section .cy_ppca_shm*  };
keep {  section .cy_live_persistent_data };

define exported symbol __crc_start__ = PPCA0_CODE_START;
define exported symbol __crc_end__   = PPCA0_CRC_START;

/* EOF */
